## Documentation/devicetree/bindings/media/amlogic,meson-g12a-demux.yaml
```yaml
# SPDX-License-Identifier: (GPL-2.0-only OR BSD-2-Clause)
%YAML 1.2
---
$id: http://devicetree.org/schemas/media/amlogic,meson-g12a-demux.yaml#
$schema: http://devicetree.org/meta-schemas/core.yaml#

title: Amlogic transport stream demultiplexer

maintainers:
  - Marek Czerski <m.czerski@ap-tech.pl>

description: |
  The demux block of the Amlogic GXBB, GXL, GXM, G12A, G12B and SM1 SoCs
  receives MPEG transport streams on up to three TS input ports, usually
  from DVB demodulators.

properties:
  compatible:
    enum:
      - amlogic,meson-gxbb-demux
      - amlogic,meson-g12a-demux

  reg:
    items:
      - description: Demux cores and their common configuration
      - description: async FIFO 0
      - description: async FIFO 1

  reg-names:
    items:
      - const: stb
      - const: asyncfifo0
      - const: asyncfifo1

  interrupts:
    items:
      - description: async FIFO 0, a chunk of the ring was written
      - description: async FIFO 1, a chunk of the ring was written

  interrupt-names:
    items:
      - const: asyncfifo0
      - const: asyncfifo1

  clocks:
    minItems: 2
    maxItems: 3

  clock-names:
    minItems: 2
    maxItems: 3

  resets:
    items:
      - description: demux
      - description: async FIFO 0
      - description: async FIFO 1

  reset-names:
    items:
      - const: demux
      - const: asyncfifo0
      - const: asyncfifo1

  ports:
    $ref: /schemas/graph.yaml#/properties/ports

    patternProperties:
      "^port@[0-2]$":
        $ref: /schemas/graph.yaml#/$defs/port-base
        unevaluatedProperties: false
        description:
          TS input 0, 1 or 2, linked to the TS output of a demodulator. A port
          has one endpoint for each demodulator wired to the input, of which
          only one may drive it at a time.

        patternProperties:
          "^endpoint(@[0-9a-f]+)?$":
            $ref: video-interfaces.yaml#
            unevaluatedProperties: false

            properties:
              bus-width:
                enum: [1, 8]
                description:
                  1 for a serial bus on data line 0, 8 for a parallel bus.

              pclk-sample:
                enum: [0, 1]
                description:
                  Sample data at the falling (0) or rising (1) edge of the TS
                  clock.

              data-enable-active:
                description:
                  Polarity of the VALID signal, 0/1 for LOW/HIGH. The default
                  is HIGH.

              ts-sync-active:
                $ref: /schemas/types.yaml#/definitions/uint32
                enum: [0, 1]
                description:
                  Polarity of the SYNC signal, which marks the first byte of a
                  packet, 0/1 for LOW/HIGH. The default is HIGH.

              ts-error-active:
                $ref: /schemas/types.yaml#/definitions/uint32
                enum: [0, 1]
                description:
                  Polarity of the ERROR signal, 0/1 for LOW/HIGH. The default
                  is HIGH.

            required:
              - bus-width

required:
  - compatible
  - reg
  - reg-names
  - interrupts
  - interrupt-names
  - clocks
  - clock-names
  - resets
  - reset-names

allOf:
  - if:
      properties:
        compatible:
          contains:
            const: amlogic,meson-gxbb-demux
    then:
      properties:
        clocks:
          items:
            - description: demux clock gate
            - description: async FIFO clock gate
            - description: AHB arbiter clock gate
        clock-names:
          items:
            - const: demux
            - const: asyncfifo
            - const: ahb_arb0
    else:
      properties:
        clocks:
          items:
            - description: demux clock gate
            - description: AHB arbiter clock gate
        clock-names:
          items:
            - const: demux
            - const: ahb_arb0

additionalProperties: false

examples:
  - |
    #include <dt-bindings/clock/g12a-clkc.h>
    #include <dt-bindings/interrupt-controller/arm-gic.h>
    #include <dt-bindings/interrupt-controller/irq.h>
    #include <dt-bindings/reset/amlogic,meson-g12a-reset.h>

    demux@ffd06000 {
        compatible = "amlogic,meson-g12a-demux";
        reg = <0xffd06000 0x400>,
              <0xffd0a000 0x10>,
              <0xffd09000 0x10>;
        reg-names = "stb", "asyncfifo0", "asyncfifo1";
        interrupts = <GIC_SPI 19 IRQ_TYPE_EDGE_RISING>,
                     <GIC_SPI 25 IRQ_TYPE_EDGE_RISING>;
        interrupt-names = "asyncfifo0", "asyncfifo1";
        clocks = <&clkc CLKID_DEMUX>, <&clkc CLKID_AHB_ARB0>;
        clock-names = "demux", "ahb_arb0";
        resets = <&reset RESET_DEMUX>,
                 <&reset RESET_ASYNC0>,
                 <&reset RESET_ASYNC1>;
        reset-names = "demux", "asyncfifo0", "asyncfifo1";

        ports {
            #address-cells = <1>;
            #size-cells = <0>;

            port@0 {
                reg = <0>;

                endpoint {
                    remote-endpoint = <&demod_ts>;
                    bus-width = <1>;
                    pclk-sample = <0>;
                };
            };
        };
    };
...
```

## Documentation/devicetree/bindings/misc/amlogic,meson-g12a-smartcard.yaml
```yaml
# SPDX-License-Identifier: (GPL-2.0-only OR BSD-2-Clause)
%YAML 1.2
---
$id: http://devicetree.org/schemas/misc/amlogic,meson-g12a-smartcard.yaml#
$schema: http://devicetree.org/meta-schemas/core.yaml#

title: Amlogic ISO 7816 smart card interface

maintainers:
  - Marek Czerski <m.czerski@ap-tech.pl>

description: |
  The smart card interface of the Amlogic GXBB, GXL, GXM, G12A, G12B and SM1
  SoCs is an ISO 7816-3 UART with a card clock generator. It drives the
  CLK and I/O lines of the card, usually through a card interface chip that
  also supplies VCC and checks the card presence. The card RST line, the
  activation of the interface chip and the presence signal are GPIOs.

properties:
  compatible:
    enum:
      - amlogic,meson-gxbb-smartcard
      - amlogic,meson-g12a-smartcard

  reg:
    maxItems: 1

  interrupts:
    maxItems: 1

  clocks:
    items:
      - description: smart card clock gate
      - description:
          fclk_div4, the source the card clock is divided from

  clock-names:
    items:
      - const: pclk
      - const: card

  resets:
    maxItems: 1

  reset-gpios:
    maxItems: 1
    description: Card RST line, asserted while the card is in reset.

  enable-gpios:
    maxItems: 1
    description:
      Activation input of the card interface chip, asserted to power the
      card (for example CMDVCC of a TDA8024).

  detect-gpios:
    maxItems: 1
    description: Card presence, asserted while a card is inserted.

required:
  - compatible
  - reg
  - interrupts
  - clocks
  - clock-names
  - reset-gpios
  - detect-gpios

additionalProperties: false

examples:
  - |
    #include <dt-bindings/clock/g12a-clkc.h>
    #include <dt-bindings/gpio/gpio.h>
    #include <dt-bindings/gpio/meson-g12a-gpio.h>
    #include <dt-bindings/interrupt-controller/arm-gic.h>
    #include <dt-bindings/interrupt-controller/irq.h>
    #include <dt-bindings/reset/amlogic,meson-g12a-reset.h>

    smartcard@ffd25000 {
        compatible = "amlogic,meson-g12a-smartcard";
        reg = <0xffd25000 0x24>;
        interrupts = <GIC_SPI 37 IRQ_TYPE_LEVEL_HIGH>;
        clocks = <&clkc CLKID_SD>, <&clkc CLKID_FCLK_DIV4>;
        clock-names = "pclk", "card";
        resets = <&reset RESET_SC>;
        pinctrl-0 = <&iso7816_h_pins>;
        pinctrl-names = "default";
        reset-gpios = <&gpio_ao GPIOAO_10 GPIO_ACTIVE_LOW>;
        enable-gpios = <&gpio_ao GPIOE_2 GPIO_ACTIVE_LOW>;
        detect-gpios = <&gpio GPIOC_7 (GPIO_ACTIVE_HIGH | GPIO_PULL_UP)>;
    };
...
```

## drivers/media/platform/amlogic/hw_demux/Kconfig
```kconfig
config DVB_MESON
	tristate "Amlogic DVB demux driver"
	depends on ARCH_MESON || COMPILE_TEST
	help
	  This is a dvb demux driver for Amlogic.
```

## drivers/media/platform/amlogic/meson-demux/Kconfig
```kconfig
# SPDX-License-Identifier: GPL-2.0-only

config DVB_MESON_DEMUX
	tristate "Amlogic transport stream demux"
	depends on DVB_CORE
	depends on ARCH_MESON || COMPILE_TEST
	help
	  Support for the transport stream demultiplexer of the Amlogic
	  GXBB, GXL, GXM, G12A, G12B and SM1 SoCs.

	  To compile this driver as a module, choose M here: the module will
	  be called meson-demux.
```

## drivers/media/platform/amlogic/meson-smartcard/Kconfig
```kconfig
# SPDX-License-Identifier: GPL-2.0-only

config MESON_SMARTCARD
	tristate "Amlogic ISO 7816 smart card interface"
	depends on ARCH_MESON || COMPILE_TEST
	help
	  Support for the ISO 7816 smart card interface of the Amlogic GXBB,
	  GXL, GXM, G12A, G12B and SM1 SoCs, used with the card slot of
	  DVB receivers. The card is accessed through /dev/smcN with the
	  interface of the Amlogic vendor driver, as used by OSCam.

	  To compile this driver as a module, choose M here: the module will
	  be called meson-smartcard.
```

## drivers/media/platform/amlogic/meson-smc/Kconfig
```kconfig
config SMARTCARD_MESON
	tristate "Amlogic Smartcard driver"
	depends on ARCH_MESON || COMPILE_TEST
	help
	  This is a Smart card reader driver for Amlogic.
```
