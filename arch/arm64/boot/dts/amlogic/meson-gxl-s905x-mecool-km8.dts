// SPDX-License-Identifier: (GPL-2.0+ OR MIT)
/*
 * Copyright (c) 2018 He Yangxuan
 */

/dts-v1/;

#include "meson-gxl-s905x-p212.dts"
#include <dt-bindings/input/input.h>

/ {
	compatible = "videostrong,gxl-km8", "amlogic,s905x", "amlogic,meson-gxl";
	model = "MeCool KM8";

	gpio-keys-polled {
		compatible = "gpio-keys-polled";
		poll-interval = <100>;

		power-button {
			label = "power";
			linux,code = <KEY_POWER>;
			gpios = <&gpio_ao GPIOAO_2 GPIO_ACTIVE_HIGH>;
		};
	};
};

/*
 * No DVB frontend on this box: the demux without TS inputs (no ports, no
 * pins), for testing the driver on GXL with streams written to dvr0.
 */
&demux {
	status = "okay";
};
