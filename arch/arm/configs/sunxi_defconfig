## arch/or32/Kconfig.mc2
```kconfig
menu "Memory Controler 2 timings"
	depends on OR32_GENERIC && OR32_GENERIC_MEMORY_TIMINGS

      #
      # FLASH timings: worst cases in ns, from data sheets

config OR32_FLASH_WA_TIME
	int "Flash Write Access Time [ns]"
	default 50

config OR32_FLASH_WE_DELAY 
	int "Flash Write Enable Delay [ns]"
	default 0

config OR32_FLASH_WH_TIME
	int "Flash Write Hold Time [ns]"
	default 0
	
config OR32_FLASH_RA_TIME
	int "Flash Read Access Time [ns]"
	default 95

config OR32_FLASH_PRA_TIME
	int "Flash Page Read Access Time [ns]"
	default 25

config OR32_FLASH_RT_TIME
	int "Flash Read Turnaround Time [ns]"
	default 24

      #
      # SDRAM timings: worst cases in ns, from data sheets

config OR32_SDRAM_tRCD 
	int "SDRAM tRCD [ns]"
	default 23

config OR32_SDRAM_tWR
	int "SDRAM tWR [ns]"
	default 20

config OR32_SDRAM_tRC
	int "SDRAM tRC [ns]"
	default 60

config OR32_SDRAM_tRFC
	int "SDRAM tRFC (sometimes the same as tRC) [ns]"
	default 60

config OR32_SDRAM_tRAS
	int "SDRAM tRAS (use the worst case minimal value) [ns]"
	default 50

config OR32_SDRAM_tRP 
	int "SDRAM tRP [ns]"
	default 23

config OR32_SDRAM_tRRD
	int "SDRAM tRRD [ns]"
	default 15

      # 64000000 / 8192 = 7812.5
config OR32_SDRAM_tREF
	int "SDRAM tREF (round it up) [ns]"
	default 7813

endmenu
```

## arch/or32/config.in
```kconfig
#
# For a description of the syntax of this configuration file,
# see Documentation/kbuild/config-language.txt.
#

mainmenu "Linux/or32 Kernel Configuration"

config MMU
	bool
	default y

config UID16
	bool
	default y

config RWSEM_GENERIC_SPINLOCK
	bool
	default y

config RWSEM_XCHGADD_ALGORITHM
	bool
	default n

source "init/Kconfig"


menu "Processor type and features"

choice 
	prompt "Subarchitecture/SoC type"
	default OR32_MARVIN

config	OR32_MARVIN
	bool "or1200/Marvin"
	help 
	  Marvin SoC

          revision 0 prototype hardware implementation


config OR32_HIGHLAND
	bool "or1200/Highland"
	help
	  Highland SoC

	  revision 1

config OR32_GENERIC
	bool "or1200/Generic"
	help
	  Generic or1200 platform

endchoice


config OR32_SYS_CLK
	int "System clock frequency [MHz]"
	default 100

config OR32_MEMORY_SIZE
	hex "System memory size [hex, bytes]"
	default 01000000

config OR32_FLASH_BOOT
	bool "Boot from FLASH"
	default n
	help
	  This alows you have support for extreamly simple bootloader
          in the kernel. It will just copy kernel image from FLASH to RAM and
	  start executing it.

#
# Generic SoC defines
#

config OR32_MC_VERSION
	int "Memory Controler Version (1 or 2)"
	range 1 2
	depends on OR32_GENERIC
	default "1"

config OR32_MC_INIT
	bool "Initilaze memory controler"
	depends on OR32_GENERIC
	default n
	help
	  This option controls memory controler initizalization

	  When using bootloader, memory controler initialization is
	  usualy done by boot the bootloader. Memory timings might not
	  be ideal, so if you know the right timings it woun't hurt to
	  enable it.

	  If booting directly from flash you need to enable this option
	  and if neccessery provide memory timings.
	  
config OR32_ICACHE_ENABLED
	bool "Enable iCACHE"
	depends on OR32_GENERIC
	default n

config OR32_IC_SIZE
	int "iCACHE size [bytes]"
	depends on OR32_GENERIC
	default 8192

config OR32_IC_LINE
	int "iCACHE line size [bytes]"
	depends on OR32_GENERIC
	default 16

config OR32_DCACHE_ENABLED
	bool "Enable dCACHE"
	depends on OR32_GENERIC
	default n

config OR32_DC_SIZE
	int "dCACHE size [bytes]"
	depends on OR32_GENERIC
	default 8192

config OR32_DC_LINE
	int "dCACHE line size [bytes]"
	depends on OR32_GENERIC
	default 16

config OR32_ITLB_ENTRIES
	int "Number of iTLB entries"
	depends on OR32_GENERIC
	default 64	

config OR32_DTLB_ENTRIES
	int "Number of dTLB entries"
	depends on OR32_GENERIC
	default 64	

config OR32_NO_SPR_SR_DSX
	bool "use SPR_SR_DSX software emulation"
	depends on OR32_GENERIC
	default y
	help
	  SPR_SR_DSX bit is status register bit indicating whether
	  the last exception has happened in delay slot.	

	  OpenRISC architecture makes it optional to have it implemented
 	  in hardware, and Marvin and Highland SoC do not have it.

	  Say N here if you know that your OpenRISC processor has
	  SPR_SR_DSX bit implemented. Say Y if you are unsure.

#
# Define implied options for the selected SoC
#
config OR32_CPU_OR1200
	bool
	depends on OR32_MARVIN || OR32_HIGHLAND || OR32_GENERIC
	default y

config OR32_MC_VERSION
	int
	depends on !OR32_GENERIC
	default "1" if OR32_MARVIN
	default "2" if OR32_HIGHLAND

config OR32_MC_INIT
	bool
	depends on !OR32_GENERIC
	default y

config OR32_ICACHE_ENABLED
	bool
	depends on !OR32_GENERIC
	default n

config OR32_IC_SIZE
	int
	depends on !OR32_GENERIC
	default 8192

config OR32_IC_LINE
	int
	depends on !OR32_GENERIC
	default 16

config OR32_DCACHE_ENABLED
	bool
	depends on !OR32_GENERIC
	default n

config OR32_DC_SIZE
	int
	depends on !OR32_GENERIC
	default 8192

config OR32_DC_LINE
	int
	depends on !OR32_GENERIC
	default 16

config OR32_ITLB_ENTRIES
	int
	depends on !OR32_GENERIC
	default 64	

config OR32_DTLB_ENTRIES
	int
	depends on !OR32_GENERIC
	default 64	

config OR32_NO_SPR_SR_DSX
	bool
	depends on !OR32_GENERIC
	default y


menu "Debuging options"

config DEBUG_STACKOVERFLOW
	bool "Check for kernel stack overflow"
	default y
	help
	  Make extra checks for space avaliable on stack in some
          critical functions. This will cause kernel to run a bit slower,
	  but will catch most of kernel stack overruns and exit gracefuly.

	  Say Y if you are unsure. 

config OR32_GUARD_PROTECTED_CORE
	bool "Write protect read only part of kernel"
	default y
	help
	  Write to .text or .rodata sections is most probably kernel bug.
	  Enabling this will cause an oops at the instruction that tries to
	  corrupt kernel.
	
	  This has no performance implication but should help locating bugs.

	  Say Y if you are unsure.

config JUMP_UPON_UNHANDLED_EXCEPTION
	bool "Try to die gracefully"
	default y
	help
	  Now this puts kernel into infinite loop after first oops. Till
	  your kernel crashes this doesn't have any influence.

	  Say Y if you are unsure.

config OR32_EXCEPTION_DEBUG
	bool "Print processor state at each exception"
	default n
	help
	  This option will make your kernel unusable for all but kernel
	  debugging.

	  Say N if you are unsure.
	

endmenu

endmenu


# OpenRISC specific drivers

source "arch/or32/drivers/Kconfig"


menu "Bus options"

config PCI
	bool "PCI support"
	default n
	help
	  Find out whether your system includes a PCI bus. PCI is the name of
	  a bus system, i.e. the way the CPU talks to the other stuff inside
	  your box.  If you say Y here, the kernel will include drivers and
	  infrastructure code to support PCI bus devices.

config PCI_DOMAINS
	bool
	default PCI

source "drivers/pci/Kconfig"

source "drivers/pcmcia/Kconfig"

# standard linux drivers
source "drivers/mtd/Kconfig"

source "drivers/parport/Kconfig"

source "drivers/pnp/Kconfig"

source "drivers/block/Kconfig"

source "drivers/md/Kconfig"

source "drivers/ide/Kconfig"

source "drivers/scsi/Kconfig"

source "drivers/ieee1394/Kconfig"

source "drivers/message/i2o/Kconfig"

source "net/Kconfig"

source "drivers/isdn/Kconfig"

source "drivers/telephony/Kconfig"

source "drivers/cdrom/Kconfig"

#
# input before char - char/joystick depends on it. As does USB.
#
source "drivers/input/Kconfig"

source "drivers/char/Kconfig"

#source drivers/misc/Config.in
source "drivers/media/Kconfig"

source "fs/Kconfig"

source "sound/Kconfig"

source "drivers/usb/Kconfig"


menu "Kernel hacking"

endmenu

source "security/Kconfig"

source "crypto/Kconfig"

source "lib/Kconfig"
```

## arch/or32/configs/aac_defconfig
```kconfig
CONFIG_EXPERIMENTAL=y
CONFIG_CROSS_COMPILE="or32-elf-"
CONFIG_LOCALVERSION="-or32"
# CONFIG_SWAP is not set
CONFIG_SYSVIPC=y
CONFIG_BSD_PROCESS_ACCT=y
CONFIG_LOG_BUF_SHIFT=14
CONFIG_BLK_DEV_INITRD=y
CONFIG_INITRAMFS_SOURCE="arch/or32/support/initramfs arch/or32/support/initramfs.devnodes"
CONFIG_EMBEDDED=y
# CONFIG_SYSCTL_SYSCALL is not set
# CONFIG_KALLSYMS is not set
# CONFIG_ELF_CORE is not set
# CONFIG_SIGNALFD is not set
# CONFIG_VM_EVENT_COUNTERS is not set
# CONFIG_COMPAT_BRK is not set
CONFIG_SLOB=y
CONFIG_MODULES=y
# CONFIG_LBDAF is not set
# CONFIG_BLK_DEV_BSG is not set
CONFIG_OR32_GENERIC=y
CONFIG_OR32_SYS_CLK=20
CONFIG_OR32_MEMORY_SIZE=0x2000000
CONFIG_OR32_RESERVED_MEM_SIZE=0x0
CONFIG_HZ_100=y
CONFIG_OR32_ICACHE_ENABLED=y
CONFIG_NET=y
CONFIG_PACKET=y
CONFIG_UNIX=y
CONFIG_NET_KEY=y
CONFIG_INET=y
CONFIG_IP_PNP=y
CONFIG_INET_AH=y
CONFIG_INET_ESP=y
CONFIG_INET_IPCOMP=y
# CONFIG_INET_XFRM_MODE_TRANSPORT is not set
# CONFIG_INET_XFRM_MODE_TUNNEL is not set
# CONFIG_INET_XFRM_MODE_BEET is not set
# CONFIG_INET_LRO is not set
# CONFIG_IPV6 is not set
# CONFIG_WIRELESS is not set
CONFIG_DEVTMPFS=y
CONFIG_DEVTMPFS_MOUNT=y
CONFIG_PROC_DEVICETREE=y
CONFIG_BLK_DEV_LOOP=y
# CONFIG_MISC_DEVICES is not set
CONFIG_SCSI=y
# CONFIG_SCSI_PROC_FS is not set
CONFIG_BLK_DEV_SD=y
# CONFIG_SCSI_LOWLEVEL is not set
CONFIG_NETDEVICES=y
CONFIG_MICREL_PHY=y
CONFIG_NET_ETHERNET=y
CONFIG_ETHOC=y
# CONFIG_NETDEV_1000 is not set
# CONFIG_NETDEV_10000 is not set
# CONFIG_WLAN is not set
CONFIG_PPP=y
CONFIG_PPP_FILTER=y
CONFIG_PPP_ASYNC=y
# CONFIG_INPUT_MOUSEDEV is not set
# CONFIG_INPUT_KEYBOARD is not set
# CONFIG_INPUT_MOUSE is not set
# CONFIG_SERIO_I8042 is not set
# CONFIG_SERIO_SERPORT is not set
CONFIG_SERIO_LIBPS2=y
CONFIG_SERIAL_8250=y
CONFIG_SERIAL_8250_CONSOLE=y
CONFIG_SERIAL_OF_PLATFORM=y
# CONFIG_LEGACY_PTYS is not set
# CONFIG_HW_RANDOM is not set
CONFIG_I2C=y
CONFIG_I2C_OCORES=y
# CONFIG_HWMON is not set
# CONFIG_MFD_SUPPORT is not set
# CONFIG_FB_OC_SHMEM is not set
# CONFIG_VGA_CONSOLE is not set
# CONFIG_HID_SUPPORT is not set
# CONFIG_USB_SUPPORT is not set
CONFIG_NEW_LEDS=y
CONFIG_LEDS_CLASS=y
CONFIG_LEDS_TRIGGERS=y
CONFIG_LEDS_TRIGGER_TIMER=y
CONFIG_LEDS_TRIGGER_HEARTBEAT=y
CONFIG_LEDS_TRIGGER_DEFAULT_ON=y
CONFIG_EXT2_FS=y
CONFIG_QUOTA=y
# CONFIG_PRINT_QUOTA_WARNING is not set
CONFIG_TMPFS=y
CONFIG_NFS_FS=y
CONFIG_NFS_V3=y
CONFIG_ROOT_NFS=y
CONFIG_NLS=y
CONFIG_CRYPTO_AES=y
# CONFIG_CRYPTO_ANSI_CPRNG is not set
# CONFIG_CRYPTO_HW is not set
# CONFIG_ENABLE_WARN_DEPRECATED is not set
# CONFIG_ENABLE_MUST_CHECK is not set
CONFIG_MAGIC_SYSRQ=y
CONFIG_DEBUG_FS=y
CONFIG_DYNAMIC_DEBUG=y
```

## arch/or32/drivers/Kconfig
```kconfig
# OpenRISC specific drivers
#

config OETH
	bool "OpenCores Ethernet support"
	default y

config OETH_UNKNOWN_TX_NEXT
	bool "Pass tx->next to linux"
	depends on OETH
	default y
	help
	  OpenCores Ethernet core does not have support to reset
	  next buffer descriptor to initial value, so bootloader must
	  pass the next buffer descriptor number if it used ethernet core.

	  In most cases Y should be a safe choice.
```
